## board/renesas/rzboard/Kconfig
```kconfig
if TARGET_RZBOARD

config SYS_SOC
	default "rmobile"

config SYS_BOARD
	default "rzboard"

config SYS_VENDOR
	default "renesas"

config SYS_CONFIG_NAME
	default "rzboard"

endif
```
